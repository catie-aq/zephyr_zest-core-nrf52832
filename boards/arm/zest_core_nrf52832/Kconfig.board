## boards/arm/zest_core_nrf52832/Kconfig.board
```kconfig
# Kconfig - Zest_Core_nRF52832 board configuration
#
# Copyright (c) 2020 
#
# SPDX-License-Identifier: Apache-2.0
#

config BOARD_ZEST_CORE_NRF52832
	bool "Zest Core nRF52832 Development Board"
	depends on SOC_NRF52832_QFAA
```

## boards/arm/zest_core_nrf52832/Kconfig.defconfig
```kconfig
# Kconfig - Zest_Core_nRF52832 board configuration
#
# Copyright (c) 2020
#
# SPDX-License-Identifier: Apache-2.0
#

if BOARD_ZEST_CORE_NRF52832

config BOARD
	default "zest_core_nrf52832"

config BT_CTLR
	default BT

endif # BOARD_ZEST_CORE_NRF52832
```

## boards/catie/zest_core_nrf52832/Kconfig.defconfig
```kconfig
# Copyright (c) 2024 CATIE
# SPDX-License-Identifier: Apache-2.0

if BOARD_ZEST_CORE_NRF52832

config HW_STACK_PROTECTION
	default ARCH_HAS_STACK_PROTECTION

endif # BOARD_ZEST_CORE_NRF52832
```

## boards/catie/zest_core_nrf52832/Kconfig.zest_core_nrf52832
```kconfig
# Copyright (c) 2024 CATIE
# SPDX-License-Identifier: Apache-2.0

config BOARD_ZEST_CORE_NRF52832
	select SOC_NRF52832_QFAA
	select NFCT_PINS_AS_GPIOS
```

## boards/catie/zest_core_nrf52832/board.yml
```yaml
board:
  name: zest_core_nrf52832
  full_name: Zest_Core_nRF52832
  vendor: catie
  socs:
    - name: nrf52832
  revision:
    format: "major.minor.patch"
    default: "1.2.1"
    exact: true
    revisions:
      - name: "1.1.0"
      - name: "1.2.1"
```

## boards/catie/zest_core_nrf52832/zest_core_nrf52832_defconfig
```kconfig
# Copyright (c) 2024 CATIE
# SPDX-License-Identifier: Apache-2.0

# enable uart driver
CONFIG_SERIAL=y

# enable console
CONFIG_CONSOLE=y
CONFIG_UART_CONSOLE=y

# enable GPIO
CONFIG_GPIO=y

# console
CONFIG_CONSOLE=y
CONFIG_UART_CONSOLE=y

# enable MPU
CONFIG_ARM_MPU=y
```
